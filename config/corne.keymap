#define HOST_OS 1

#include <behaviors.dtsi>
#include <dt-bindings/zmk/keys.h>
#include <dt-bindings/zmk/pointing.h>
#include <zmk-helpers/helper.h>
#include <zmk-helpers/unicode-chars/danish.dtsi>

#define AS(keycode) &as LS(keycode) keycode     // Autoshift Macro
#define DEFAULT 0
#define NUMBERS   1
#define FUNCTION   2
#define MOUSE   3
#define ACCENT   4

#define ZMK_POINTING_DEFAULT_MOVE_VAL 900  // default: 600
#define ZMK_POINTING_DEFAULT_SCRL_VAL 5    // default: 10

ZMK_UNICODE_SINGLE(curr_euro,       N2, N0, A, C)  // € (Euro)
ZMK_UNICODE_PAIR(a_grave,        N0, N0, E, N0,   N0, N0, C, N0)  // à/À
ZMK_UNICODE_PAIR(e_grave,        N0, N0, E, N8,   N0, N0, C, N8)  // è/È
ZMK_UNICODE_PAIR(i_grave,        N0, N0, E, C,   N0, N0, C, C)  // ì/Ì
ZMK_UNICODE_PAIR(o_grave,        N0, N0, F, N2,   N0, N0, D, N2)  // ò/Ò
ZMK_UNICODE_PAIR(u_grave,        N0, N0, F, N9,   N0, N0, D, N9)  // ù/Ù

&lt {
    tapping-term-ms = <250>;
};

/ {
        behaviors {
                as: auto_shift {
                        compatible = "zmk,behavior-hold-tap";
                        #binding-cells = <2>;
                        tapping_term_ms = <175>;
                        quick_tap_ms = <0>;
                        flavor = "tap-preferred";
                        bindings = <&kp>, <&kp>;
                };
        };


        keymap {
                compatible = "zmk,keymap";

                DEFAULT_layer {
                        bindings = <
   &kp TAB   &kp Q &kp W &kp E &kp R &kp T   &kp Y &kp U  &kp I     &kp O   &kp P     AS(MINUS)
   &kp LSHFT &kp A &kp S &kp D &kp F &kp G   &kp H &kp J  &kp K     &kp L   AS(SEMI) AS(SQT)
   &kp LCTRL &kp Z &kp X &kp C &kp V &kp B   &kp N &kp M  AS(COMMA) AS(DOT) AS(FSLH) AS(DEL)
                  &kp LALT &mo NUMBERS &kp SPACE   &lt MOUSE RET &mo FUNCTION &kp BSPC
                        >;
                };

                NUMBERS_layer {
                        bindings = <
   &trans    AS(N1)   AS(N2)   AS(N3)     AS(N4)     AS(N5)             AS(N6)    AS(N7)   AS(N8) AS(N9)    AS(N0) &trans
   &trans    &none    &none    &kp DEL    &kp ESC    &kp RGUI           AS(GRAVE)  AS(EQUAL)  AS(BSLH)  AS(LBKT)  AS(RBKT)  AS(UNDERSCORE)
   &trans  &kp LC(Z) &kp LC(X) &kp LC(C) &kp LC(V) &kp LC(Y)            &kp L &none &none &none &none &trans
                                 &trans  &trans   &trans              &trans  &mo ACCENT   &trans
                        >;
                };

                FUNCTION_layer {
                        bindings = <
   &trans &kp F1 &kp F2 &kp F3 &kp F4 &kp F5            &none &kp PG_UP &kp UP &kp PG_DN &kp PSCRN &kp C_VOL_UP
   &trans &kp F6 &kp F7 &kp F8 &kp F9 &kp F10           &none &kp LEFT &kp DOWN &kp RIGHT &none &kp C_VOL_DN
   &trans &kp F11 &kp F12 &none &none &none             &none &kp HOME &none &kp END &none &kp C_MUTE
                             &trans  &mo ACCENT   &trans    &trans  &trans   &trans
                        >;
                };

                MOUSE_layer {
                        bindings = <
    &trans &none  &none  &none  &none  &none         &mkp MB2 &msc SCRL_UP &mmv MOVE_UP &msc SCRL_DOWN &none &none
    &trans &none  &none  &none  &none  &none         &mkp MB1 &mmv MOVE_LEFT &mmv MOVE_DOWN &mmv MOVE_RIGHT &none &none
    &trans &none  &none  &none  &none  &none         &mkp MB3 &none  &none  &none  &none  &none
                 &trans &none &trans          &trans &none &trans
                        >;
                };

                 ACCENT_layer {
                        bindings = <
    &trans &none  &none  &e_grave  &curr_euro  &none         &none &u_grave &i_grave &o_grave &none &da_aa
    &trans &a_grave  &none  &none  &none  &none         &none &none &none &none &da_ae &da_oe
    &trans &none  &none  &none  &none  &none         &none &none &none &none &none &none
                 &trans &none &trans          &trans &none &trans
                        >;
                };
        };
};
