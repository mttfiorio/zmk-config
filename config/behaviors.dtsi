/ {
    behaviors {
        no_auto_shift: no_auto_shift {
            compatible = "zmk,behavior-mod-morph";
            label = "NO_AUTO_SHIFT";
            #binding-cells = <0>;
            bindings = <&kp>;
            mods = <(MOD_LSFT)>;
            mod-mask = <(MOD_LSFT)>;
            global-behavior = "no-auto-shift";
        };
    };
};

